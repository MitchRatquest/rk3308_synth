## rk3308/configs/rockpis_defconfig
```kconfig
BR2_aarch64=y
BR2_cortex_a35=y
BR2_TOOLCHAIN_BUILDROOT_MUSL=y
BR2_TOOLCHAIN_BUILDROOT_CXX=y
BR2_TOOLCHAIN_BUILDROOT_FORTRAN=y
BR2_DL_DIR="$(BASE_DIR)/download"
BR2_CCACHE=y
BR2_GLOBAL_PATCH_DIR="$(BR2_EXTERNAL)/patches"
BR2_TARGET_GENERIC_HOSTNAME="rockpis"
BR2_TARGET_GENERIC_ISSUE="Welcome to a RockPi S OS"
BR2_TARGET_GENERIC_ROOT_PASSWD="root"
BR2_SYSTEM_BIN_SH_BASH=y
BR2_ROOTFS_OVERLAY="$(BR2_EXTERNAL)/overlays"
BR2_ROOTFS_POST_IMAGE_SCRIPT="$(BR2_EXTERNAL)/board/post-image.sh"
BR2_ROOTFS_POST_SCRIPT_ARGS="RK3308"
BR2_LINUX_KERNEL=y
BR2_LINUX_KERNEL_CUSTOM_VERSION=y
BR2_LINUX_KERNEL_CUSTOM_VERSION_VALUE="6.6.66"
BR2_LINUX_KERNEL_USE_CUSTOM_CONFIG=y
BR2_LINUX_KERNEL_CUSTOM_CONFIG_FILE="$(BR2_EXTERNAL)/board/rockpi-s0-linux_defconfig"
BR2_LINUX_KERNEL_CONFIG_FRAGMENT_FILES="$(BR2_EXTERNAL)/package/example-module-overlay/module-overlay-rk3308/kernel.fragment"
BR2_LINUX_KERNEL_DTS_SUPPORT=y
BR2_LINUX_KERNEL_INTREE_DTS_NAME="rockchip/rk3308-rock-s0"
BR2_PACKAGE_LINUX_TOOLS_CPUPOWER=y
BR2_PACKAGE_BUSYBOX_CONFIG="$(BR2_EXTERNAL)/configs/busybox_defconfig"
BR2_PACKAGE_BUSYBOX_SHOW_OTHERS=y
BR2_PACKAGE_BUSYBOX_INDIVIDUAL_BINARIES=y
BR2_PACKAGE_PIGZ=y
BR2_PACKAGE_ZSTD=y
BR2_PACKAGE_COREMARK=y
BR2_PACKAGE_COREMARK_PRO=y
BR2_PACKAGE_DHRYSTONE=y
BR2_PACKAGE_KEXEC=y
BR2_PACKAGE_KEXEC_ZLIB=y
BR2_PACKAGE_LATENCYTOP=y
BR2_PACKAGE_LSOF=y
BR2_PACKAGE_MEMSTAT=y
BR2_PACKAGE_RAMSPEED=y
BR2_PACKAGE_STRACE=y
BR2_PACKAGE_STRESS=y
BR2_PACKAGE_BINUTILS=y
BR2_PACKAGE_BINUTILS_TARGET=y
BR2_PACKAGE_GAWK=y
BR2_PACKAGE_GETTEXT=y
BR2_PACKAGE_GREP=y
BR2_PACKAGE_JO=y
BR2_PACKAGE_JQ=y
BR2_PACKAGE_PATCH=y
BR2_PACKAGE_RIPGREP=y
BR2_PACKAGE_SED=y
BR2_PACKAGE_TREE=y
BR2_PACKAGE_E2FSPROGS_RESIZE2FS=y
BR2_PACKAGE_E2TOOLS=y
BR2_PACKAGE_MMC_UTILS=y
BR2_PACKAGE_DBUS=y
BR2_PACKAGE_MEMTOOL=y
BR2_PACKAGE_MHZ=y
BR2_PACKAGE_POWERTOP=y
BR2_PACKAGE_SETSERIAL=y
BR2_PACKAGE_UBOOT_TOOLS=y
BR2_PACKAGE_UBOOT_TOOLS_MKIMAGE=y
BR2_PACKAGE_PYTHON3=y
BR2_PACKAGE_PYTHON3_PY_PYC=y
BR2_PACKAGE_PYTHON3_CURSES=y
BR2_PACKAGE_PYTHON3_DECIMAL=y
BR2_PACKAGE_PYTHON3_READLINE=y
BR2_PACKAGE_PYTHON3_SSL=y
BR2_PACKAGE_PYTHON3_SQLITE=y
BR2_PACKAGE_PYTHON3_XZ=y
BR2_PACKAGE_PYTHON3_ZLIB=y
BR2_PACKAGE_PYTHON_BOTTLE=y
BR2_PACKAGE_PYTHON_WS4PY=y
BR2_PACKAGE_SQLITE_STAT4=y
BR2_PACKAGE_SQLITE_ENABLE_COLUMN_METADATA=y
BR2_PACKAGE_SQLITE_ENABLE_FTS3=y
BR2_PACKAGE_SQLITE_ENABLE_JSON1=y
BR2_PACKAGE_SQLITE_ENABLE_UNLOCK_NOTIFY=y
BR2_PACKAGE_SQLITE_SECURE_DELETE=y
BR2_PACKAGE_SQLITE_NO_SYNC=y
BR2_PACKAGE_LIBGPIOD=y
BR2_PACKAGE_LIBGPIOD_TOOLS=y
BR2_PACKAGE_LIBDAEMON=y
BR2_PACKAGE_NCURSES_WCHAR=y
BR2_PACKAGE_NCURSES_TARGET_PROGS=y
BR2_PACKAGE_XUTIL_UTIL_MACROS=y
BR2_PACKAGE_BMON=y
BR2_PACKAGE_DNSMASQ=y
BR2_PACKAGE_HOSTAPD=y
BR2_PACKAGE_IPTABLES=y
BR2_PACKAGE_OPENSSH=y
BR2_PACKAGE_RSYNC=y
BR2_PACKAGE_SOCAT=y
BR2_PACKAGE_WAVEMON=y
BR2_PACKAGE_WGET=y
BR2_PACKAGE_WPA_SUPPLICANT=y
BR2_PACKAGE_WPA_SUPPLICANT_AP_SUPPORT=y
BR2_PACKAGE_WPA_SUPPLICANT_WIFI_DISPLAY=y
BR2_PACKAGE_WPA_SUPPLICANT_OVERRIDES=y
BR2_PACKAGE_WPA_SUPPLICANT_HOTSPOT=y
BR2_PACKAGE_WPA_SUPPLICANT_CLI=y
BR2_PACKAGE_WPA_SUPPLICANT_PASSPHRASE=y
BR2_PACKAGE_BASH_COMPLETION=y
BR2_PACKAGE_FILE=y
BR2_PACKAGE_SCREEN=y
BR2_PACKAGE_TIME=y
BR2_PACKAGE_WHICH=y
BR2_PACKAGE_COREUTILS=y
BR2_PACKAGE_COREUTILS_INDIVIDUAL_BINARIES=y
BR2_PACKAGE_CPULOAD=y
BR2_PACKAGE_HTOP=y
BR2_PACKAGE_KMOD=y
BR2_PACKAGE_KMOD_TOOLS=y
BR2_PACKAGE_UTIL_LINUX_KILL=y
BR2_PACKAGE_UTIL_LINUX_LAST=y
BR2_PACKAGE_UTIL_LINUX_LINE=y
BR2_PACKAGE_UTIL_LINUX_RFKILL=y
BR2_PACKAGE_UTIL_LINUX_SWITCH_ROOT=y
BR2_PACKAGE_UTIL_LINUX_ZRAMCTL=y
BR2_PACKAGE_LESS=y
BR2_PACKAGE_NANO=y
BR2_PACKAGE_VIM=y
BR2_TARGET_ROOTFS_EXT2=y
BR2_TARGET_ROOTFS_EXT2_4=y
BR2_TARGET_ROOTFS_EXT2_SIZE="256M"
BR2_TARGET_ROOTFS_EXT2_RESBLKS=10
BR2_TARGET_UBOOT=y
BR2_TARGET_UBOOT_BUILD_SYSTEM_KCONFIG=y
BR2_TARGET_UBOOT_CUSTOM_VERSION=y
BR2_TARGET_UBOOT_CUSTOM_VERSION_VALUE="2025.01-rc4"
BR2_TARGET_UBOOT_USE_CUSTOM_CONFIG=y
BR2_TARGET_UBOOT_CUSTOM_CONFIG_FILE="$(BR2_EXTERNAL)/configs/uboot_defconfig"
BR2_TARGET_UBOOT_NEEDS_DTC=y
BR2_TARGET_UBOOT_NEEDS_PYLIBFDT=y
BR2_TARGET_UBOOT_NEEDS_PYELFTOOLS=y
BR2_TARGET_UBOOT_CUSTOM_MAKEOPTS="ROCKCHIP_TPL=$(BR2_EXTERNAL_rk3308_PATH)/board/rk3308_ddr_589MHz_uart0_m0_dec3_v2.10.bin  BL31=$(BR2_EXTERNAL_rk3308_PATH)/board/rk3308_bl31_v2.26.elf"
BR2_PACKAGE_HOST_DOSFSTOOLS=y
BR2_PACKAGE_HOST_E2TOOLS=y
BR2_PACKAGE_HOST_GENEXT2FS=y
BR2_PACKAGE_HOST_GENIMAGE=y
BR2_PACKAGE_HOST_MTOOLS=y
BR2_PACKAGE_HOST_PIGZ=y
BR2_PACKAGE_HOST_UBOOT_TOOLS=y
BR2_PACKAGE_NODOGSPLASH=y
BR2_PACKAGE_WEBSOCAT=y
BR2_PACKAGE_FZF=y
BR2_PACKAGE_RKBIN=y
```

## rk3308/package/Config.in
```kconfig
menu "Packages"
source "$BR2_EXTERNAL_rk3308_PATH/package/orca/Config.in"
source "$BR2_EXTERNAL_rk3308_PATH/package/puredata/Config.in"

if BR2_PACKAGE_PUREDATA
menu "Puredata externals"
        source "$BR2_EXTERNAL_rk3308_PATH/package/flext/Config.in"
        source "$BR2_EXTERNAL_rk3308_PATH/package/puredata-aconnect/Config.in"
        source "$BR2_EXTERNAL_rk3308_PATH/package/puredata-adaptive/Config.in"
        source "$BR2_EXTERNAL_rk3308_PATH/package/puredata-bassemu/Config.in"
        source "$BR2_EXTERNAL_rk3308_PATH/package/puredata-beatpipe/Config.in"
        source "$BR2_EXTERNAL_rk3308_PATH/package/puredata-boids/Config.in"
        source "$BR2_EXTERNAL_rk3308_PATH/package/puredata-bytebeat/Config.in"
        source "$BR2_EXTERNAL_rk3308_PATH/package/puredata-bytestruct/Config.in"
        source "$BR2_EXTERNAL_rk3308_PATH/package/puredata-bsaylor/Config.in"
        source "$BR2_EXTERNAL_rk3308_PATH/package/puredata-chaos/Config.in"
        source "$BR2_EXTERNAL_rk3308_PATH/package/puredata-comport/Config.in"
        source "$BR2_EXTERNAL_rk3308_PATH/package/puredata-cyclone/Config.in"
        source "$BR2_EXTERNAL_rk3308_PATH/package/puredata-dwlib/Config.in"
        source "$BR2_EXTERNAL_rk3308_PATH/package/puredata-else/Config.in"
        source "$BR2_EXTERNAL_rk3308_PATH/package/puredata-fftease/Config.in"
        source "$BR2_EXTERNAL_rk3308_PATH/package/puredata-file/Config.in"
        source "$BR2_EXTERNAL_rk3308_PATH/package/puredata-ggee/Config.in"
        source "$BR2_EXTERNAL_rk3308_PATH/package/puredata-holzilib/Config.in"
        source "$BR2_EXTERNAL_rk3308_PATH/package/puredata-hysteresis/Config.in"
        source "$BR2_EXTERNAL_rk3308_PATH/package/puredata-iem16/Config.in"
        source "$BR2_EXTERNAL_rk3308_PATH/package/puredata-iemlib/Config.in"
        source "$BR2_EXTERNAL_rk3308_PATH/package/puredata-iemguts/Config.in"
        source "$BR2_EXTERNAL_rk3308_PATH/package/puredata-iemmatrix/Config.in"
        source "$BR2_EXTERNAL_rk3308_PATH/package/puredata-iemnet/Config.in"
        source "$BR2_EXTERNAL_rk3308_PATH/package/puredata-iemspec2/Config.in"
        source "$BR2_EXTERNAL_rk3308_PATH/package/puredata-iemtab/Config.in"
        source "$BR2_EXTERNAL_rk3308_PATH/package/puredata-mi4pd/Config.in"
        source "$BR2_EXTERNAL_rk3308_PATH/package/puredata-mediasettings/Config.in"
        source "$BR2_EXTERNAL_rk3308_PATH/package/puredata-mmb/Config.in"
        source "$BR2_EXTERNAL_rk3308_PATH/package/puredata-mrpeach/Config.in"
        source "$BR2_EXTERNAL_rk3308_PATH/package/puredata-py4pd/Config.in"
        source "$BR2_EXTERNAL_rk3308_PATH/package/puredata-shadylib/Config.in"
        source "$BR2_EXTERNAL_rk3308_PATH/package/puredata-xsample/Config.in"
        source "$BR2_EXTERNAL_rk3308_PATH/package/puredata-zexy/Config.in"
endmenu
endif 
source "$BR2_EXTERNAL_rk3308_PATH/package/nodogsplash/Config.in"
source "$BR2_EXTERNAL_rk3308_PATH/package/websocat/Config.in"
source "$BR2_EXTERNAL_rk3308_PATH/package/fzf/Config.in"
source "$BR2_EXTERNAL_rk3308_PATH/package/python-pychord/Config.in"
source "$BR2_EXTERNAL_rk3308_PATH/package/python-osc/Config.in"
source "$BR2_EXTERNAL_rk3308_PATH/package/gtkiostream/Config.in"
source "$BR2_EXTERNAL_rk3308_PATH/package/rkbin/Config.in"
source "$BR2_EXTERNAL_rk3308_PATH/package/rktools/Config.in"
source "$BR2_EXTERNAL_rk3308_PATH/package/rkdevice/Config.in"
source "$BR2_EXTERNAL_rk3308_PATH/package/rtk_hciattach/Config.in"
source "$BR2_EXTERNAL_rk3308_PATH/package/example-module-overlay/Config.in"
endmenu
```

## rk3308/package/flext/Config.in
```kconfig
config BR2_PACKAGE_FLEXT
	bool "flext"
	depends on BR2_INSTALL_LIBSTDCPP
	depends on BR2_PACKAGE_PUREDATA

	help
	  helper lib for puredata externals
```

## rk3308/package/fzf/Config.in
```kconfig
config BR2_PACKAGE_FZF
	bool "fzf"
	depends on BR2_PACKAGE_HOST_GO_TARGET_ARCH_SUPPORTS

	help
	  A command line fuzzy finder

	  https://github.com/junegunn/fzf
```

## rk3308/package/kiwix-tools/Config.in
```kconfig
config BR2_PACKAGE_KIWIX_TOOLS
	bool "kiwix-tools"
        select BR2_PACKAGE_LIBZIM
	select BR2_PACKAGE_LIBKIWIX
	help
	  The Kiwix tools is a collection of 
	  Kiwix related command line tools

	  https://github.com/kiwix/kiwix-tools
```

## rk3308/package/libkiwix/Config.in
```kconfig
config BR2_PACKAGE_LIBKIWIX
	bool "libkiwix"
        select BR2_PACKAGE_LIBZIM
	select BR2_PACKAGE_ICU
	select BR2_PACKAGE_ZLIB
	select BR2_PACKAGE_LIBCURL
	select BR2_PACKAGE_PUGIXML
	select BR2_PACKAGE_MICROHTTPD
	select BR2_PACKAGE_MUSTACHE
	help
	  Common code base for all Kiwix ports
```

## rk3308/package/libzim/Config.in
```kconfig
config BR2_PACKAGE_LIBZIM
	bool "libzim"
        select BR2_PACKAGE_LZMA
	select BR2_PACKAGE_ICU
	select BR2_PACKAGE_ZSTD
	select BR2_PACKAGE_XAPIAN
	help
	  Reference implementation of the ZIM spec
```

## rk3308/package/mustache/Config.in
```kconfig
config BR2_PACKAGE_MUSTACHE
	bool "mustache"
	help
	  Mustache text templates for modern C++
```

## rk3308/package/nodogsplash/Config.in
```kconfig
config BR2_PACKAGE_NODOGSPLASH
	bool "nodogsplash"
	select BR2_PACKAGE_LIBMICROHTTPD
	
	help
	  Nodogsplash offers a simple way to provide
	  restricted access to an Internet connection
	  using a captive portal
```

## rk3308/package/orca/Config.in
```kconfig
config BR2_PACKAGE_ORCA
	bool "orca"
	select BR2_PACKAGE_NCURSES
	select BR2_PACKAGE_NCURSES_WCHAR
	
	help
	  Orca is an esoteric programming language designed 
	  to quickly create procedural sequencers
```

## rk3308/package/pocketpy/Config.in
```kconfig
config BR2_PACKAGE_POCKETPY
	bool "pocketpy"
	help
	  Portable Python 3.x Interpreter in Modern C
	  for Game Scripting
```

## rk3308/package/puredata-aconnect/Config.in
```kconfig
config BR2_PACKAGE_PUREDATA_ACONNECT
	bool "puredata-aconnect"
	depends on BR2_PACKAGE_PUREDATA
	help
	  Collection of general purpose objects and filters
```

## rk3308/package/puredata-adaptive/Config.in
```kconfig
config BR2_PACKAGE_PUREDATA_ADAPTIVE
	bool "puredata-adaptive"
	depends on BR2_PACKAGE_PUREDATA
	help
	  an adative system which tries to learn from signals
	  of the past
```

## rk3308/package/puredata-automatonism-reloaded/Config.in
```kconfig
config BR2_PACKAGE_PUREDATA_AUTOMATONISM_RELOADED
	bool "puredata-automatonism-reloaded"
	depends on BR2_PACKAGE_PUREDATA
	depends on BR2_PACKAGE_PUREDATA_IEMGUTS
	help
	  Automatonism fork with new features: midi learn,
	  in-patch state saving, DAW integration
```

## rk3308/package/puredata-bassemu/Config.in
```kconfig
config BR2_PACKAGE_PUREDATA_BASSEMU
	bool "puredata-bassemu"
	depends on BR2_PACKAGE_PUREDATA
	help
	  an object that simulates a transistor-based electronic synthesizer
```

## rk3308/package/puredata-beatpipe/Config.in
```kconfig
config BR2_PACKAGE_PUREDATA_BEATPIPE
	bool "puredata-beatpipe"
	depends on BR2_PACKAGE_PUREDATA
	help
	  A realtime scheduler, event-delay, and quantizer object 
```

## rk3308/package/puredata-boids/Config.in
```kconfig
config BR2_PACKAGE_PUREDATA_BOIDS
	bool "puredata-boids"
	depends on BR2_PACKAGE_PUREDATA
	help
	  Collection of general purpose objects and filters
```

## rk3308/package/puredata-bsaylor/Config.in
```kconfig
config BR2_PACKAGE_PUREDATA_BSAYLOR
	bool "puredata-bsaylor"
	depends on BR2_PACKAGE_PUREDATA
	help
	  Collection of objects
```

## rk3308/package/puredata-bytebeat/Config.in
```kconfig
config BR2_PACKAGE_PUREDATA_BYTEBEAT
	bool "puredata-bytebeat"
	depends on BR2_PACKAGE_PUREDATA
	help
	  Bytebeat for Pure Data
```

## rk3308/package/puredata-chaos/Config.in
```kconfig
config BR2_PACKAGE_PUREDATA_CHAOS
	bool "puredata-chaos"
	depends on BR2_PACKAGE_PUREDATA
	help
	  set of objects for PD which calculate
	  various "Chaotic Attractors"
```

## rk3308/package/puredata-comport/Config.in
```kconfig
config BR2_PACKAGE_PUREDATA_COMPORT
	bool "puredata-comport"
	depends on BR2_PACKAGE_PUREDATA
	help
	  accessing the serial port from within Pd
```

## rk3308/package/puredata-creb/Config.in
```kconfig
config BR2_PACKAGE_PUREDATA_CREB
	bool "puredata-creb"
	depends on BR2_PACKAGE_PUREDATA
	help
	  Tom Schouten's abstractions & externals 
	  library for Pure Data
```

## rk3308/package/puredata-cxc/Config.in
```kconfig
config BR2_PACKAGE_PUREDATA_CXC
	bool "puredata-cxc"
	depends on BR2_PACKAGE_PUREDATA
	help
	  Library for working with patterns and numbers
```

## rk3308/package/puredata-cyclone/Config.in
```kconfig
config BR2_PACKAGE_PUREDATA_CYCLONE
	bool "puredata-cyclone"
	depends on BR2_PACKAGE_PUREDATA
	help
	  Collection of general purpose objects and filters
```
