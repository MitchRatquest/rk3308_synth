## rk3308/package/puredata-dwlib/Config.in
```kconfig
config BR2_PACKAGE_PUREDATA_DWLIB
	bool "puredata-dwlib"
	depends on BR2_PACKAGE_PUREDATA
	help
	  Collection of general purpose objects and filters
```

## rk3308/package/puredata-earplug/Config.in
```kconfig
config BR2_PACKAGE_PUREDATA_EARPLUG
	bool "puredata-earplug"
	depends on BR2_PACKAGE_PUREDATA
	help
	  Realtime binaural filter (HRTF) based on 
	  KEMAR impulse measurement
```

## rk3308/package/puredata-ekext/Config.in
```kconfig
config BR2_PACKAGE_PUREDATA_EKEXT
	bool "puredata-ekext"
	depends on BR2_PACKAGE_PUREDATA
	help
	  Another lib
	  https://sharktracks.co.uk/html/software.html
```

## rk3308/package/puredata-else/Config.in
```kconfig
config BR2_PACKAGE_PUREDATA_ELSE
	bool "puredata-else"
	depends on BR2_PACKAGE_PUREDATA
	help
	  Collection of general purpose objects and filters
```

## rk3308/package/puredata-ext13/Config.in
```kconfig
config BR2_PACKAGE_PUREDATA_EXT13
	bool "puredata-ext13"
	depends on BR2_PACKAGE_PUREDATA
	help
	  ext13 is a collection of various externals for Pd
```

## rk3308/package/puredata-fftease/Config.in
```kconfig
config BR2_PACKAGE_PUREDATA_FFTEASE
	bool "puredata-fftease"
	depends on BR2_PACKAGE_PUREDATA
	help
	  Collection of general purpose objects and filters
```

## rk3308/package/puredata-ggee/Config.in
```kconfig
config BR2_PACKAGE_PUREDATA_GGEE
	bool "puredata-ggee"
	depends on BR2_PACKAGE_PUREDATA
	help
	  hardware support, synths, fiter, gui, 
	  and streaming utilities
```

## rk3308/package/puredata-holzilib/Config.in
```kconfig
config BR2_PACKAGE_PUREDATA_HOLZILIB
	bool "puredata-holzilib"
	depends on BR2_PACKAGE_PUREDATA
	select BR2_PACKAGE_PUREDATA_ZEXY
	select BR2_PACKAGE_PUREDATA_IEMLIB
	select BR2_PACKAGE_PUREDATA_XSAMPLE
	help
	  a collection of useful patches
```

## rk3308/package/puredata-hysteresis/Config.in
```kconfig
config BR2_PACKAGE_PUREDATA_HYSTERESIS
	bool "puredata-hysteresis"
	depends on BR2_PACKAGE_PUREDATA
	help
	  Collection of general purpose objects and filters
```

## rk3308/package/puredata-iemguts/Config.in
```kconfig
config BR2_PACKAGE_PUREDATA_IEMGUTS
	bool "puredata-iemguts"
	depends on BR2_PACKAGE_PUREDATA
	help
	  working the intestines of Pd
```

## rk3308/package/puredata-iemlib/Config.in
```kconfig
config BR2_PACKAGE_PUREDATA_IEMLIB
	bool "puredata-iemlib"
	depends on BR2_PACKAGE_PUREDATA
	help
	  Collection of general purpose objects and filters
```

## rk3308/package/puredata-iemmatrix/Config.in
```kconfig
config BR2_PACKAGE_PUREDATA_IEMMATRIX
	bool "puredata-iemmatrix"
	depends on BR2_PACKAGE_PUREDATA
	select BR2_PACKAGE_FFTW
	select BR2_PACKAGE_LIBSNDFILE
	help
	  Collection of general purpose objects and filters
```

## rk3308/package/puredata-iemnet/Config.in
```kconfig
config BR2_PACKAGE_PUREDATA_IEMNET
	bool "puredata-iemnet"
	depends on BR2_PACKAGE_PUREDATA
	help
	  Collection of general purpose objects and filters
```

## rk3308/package/puredata-iemspec2/Config.in
```kconfig
config BR2_PACKAGE_PUREDATA_IEMSPEC2
	bool "puredata-iemspec2"
	depends on BR2_PACKAGE_PUREDATA
	help
	  Collection of general purpose objects and filters
```

## rk3308/package/puredata-iemtab/Config.in
```kconfig
config BR2_PACKAGE_PUREDATA_IEMTAB
	bool "puredata-iemtab"
	depends on BR2_PACKAGE_PUREDATA
	help
	  Collection of general purpose objects and filters
```

## rk3308/package/puredata-lyonpotpourri/Config.in
```kconfig
config BR2_PACKAGE_PUREDATA_LYONPOTPOURRI
	bool "puredata-lyonpotpourri"
	depends on BR2_PACKAGE_PUREDATA
	help
	  A collection of externals developed for 
	  the creation and performance of computer music
```

## rk3308/package/puredata-mediasettings/Config.in
```kconfig
config BR2_PACKAGE_PUREDATA_MEDIASETTINGS
	bool "puredata-mediasettings"
	depends on BR2_PACKAGE_PUREDATA
	depends on BR2_PACKAGE_ALSA_LIB
	help
	  Collection of general purpose objects and filters
```

## rk3308/package/puredata-mi4pd/Config.in
```kconfig
config BR2_PACKAGE_PUREDATA_MI4PD
	bool "puredata-mi4pd"
	depends on BR2_PACKAGE_PUREDATA
	help
	  Collection of general purpose objects and filters
```

## rk3308/package/puredata-mmb/Config.in
```kconfig
config BR2_PACKAGE_PUREDATA_MMB
	bool "puredata-mmb"
	depends on BR2_PACKAGE_PUREDATA
	help
	  Collection of general purpose objects and filters
```

## rk3308/package/puredata-mrpeach/Config.in
```kconfig
config BR2_PACKAGE_PUREDATA_MRPEACH
	bool "puredata-mrpeach"
	depends on BR2_PACKAGE_PUREDATA
	help
	  puredata external with utilities for networking, osc,
	  slip, and other useful glue
```

## rk3308/package/puredata-py4pd/Config.in
```kconfig
config BR2_PACKAGE_PUREDATA_PY4PD
	bool "puredata py4pd"
	depends on BR2_PACKAGE_PUREDATA
	depends on BR2_PACKAGE_PYTHON3
	depends on BR2_PACKAGE_PYTHON_NUMPY

	help
	  py4pd allows the use of Python as an object
	  in PureData. 

	  https://py4pd.readthedocs.io/en/stable/
```

## rk3308/package/puredata-xsample/Config.in
```kconfig
config BR2_PACKAGE_PUREDATA_XSAMPLE
	bool "puredata-xsample"
	depends on BR2_PACKAGE_PUREDATA
	select BR2_PACKAGE_FLEXT
	help
	  Extended sample objects
```

## rk3308/package/puredata-zexy/Config.in
```kconfig
config BR2_PACKAGE_PUREDATA_ZEXY
	bool "puredata-zexy"
	depends on BR2_PACKAGE_PUREDATA
	help
	  The swiss army knife for puredata
```

## rk3308/package/puredata/Config.in
```kconfig
config BR2_PACKAGE_PUREDATA
	bool "puredata"
	select BR2_PACKAGE_TCL
	select BR2_PACKAGE_XORG7
	select BR2_PACKAGE_GETTEXT
	select BR2_PACKAGE_TK

	help
	  Graphic realtime audio programming language

	  https://github.com/pure-data/pure-data

if BR2_PACKAGE_PUREDATA

config BR2_PACKAGE_LIBPD
	bool "libpd"
	depends on BR2_PACKAGE_PUREDATA
	help
	  Pure Data embeddable audio synthesis library

config BR2_PACKAGE_LIBPD_UTILS
	bool "libpd utils"
	depends on BR2_PACKAGE_LIBPD
	help
	  Compile utilities into the libpd library

config BR2_PACKAGE_LIBPD_INSTANCE
	bool "libpd instance"
	depends on BR2_PACKAGE_LIBPD
	help
	  Allow libpd multi-instance support

config BR2_PACKAGE_LIBPD_EXTRA
	bool "libpd extras"
	depends on BR2_PACKAGE_LIBPD
	help
	  Compile extras~ into library 

endif
```

## rk3308/package/python-osc/Config.in
```kconfig
config BR2_PACKAGE_PYTHON_OSC
	bool "python-osc"
	depends on BR2_PACKAGE_PYTHON || BR2_PACKAGE_PYTHON3
	help
	  Open Sound Control server and client
	  in pure python
```
