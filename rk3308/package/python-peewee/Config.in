## rk3308/package/python-peewee/Config.in
```kconfig
config BR2_PACKAGE_PYTHON_PEEWEE
	bool "python-peewee"
	depends on BR2_PACKAGE_PYTHON || BR2_PACKAGE_PYTHON3
	help
	  A small, expressive orm
	  supports postgresql, mysql, sqlite and cockroachdb
```

## rk3308/package/python-pychord/Config.in
```kconfig
config BR2_PACKAGE_PYTHON_PYCHORD
	bool "python-pychord"
	depends on BR2_PACKAGE_PYTHON || BR2_PACKAGE_PYTHON3
	help
	  An implementation of the WebSocket Protocol (RFC 6455 &
	  7692).

	  https://github.com/aaugustin/websockets
```

## rk3308/package/websocat/Config.in
```kconfig
config BR2_PACKAGE_WEBSOCAT
	bool "websocat"
	depends on BR2_PACKAGE_HOST_RUSTC_TARGET_ARCH_SUPPORTS
	select BR2_PACKAGE_HOST_RUSTC
	help
	  Command-line client for WebSockets, like netcat (or curl)
	  for ws:// with advanced socat-like functions

	  https://github.com/vi/websocat
```

## rk3308/package/websocketd/Config.in
```kconfig
config BR2_PACKAGE_WEBSOCKETD
	bool "websocketd"
	depends on BR2_PACKAGE_HOST_GO_TARGET_ARCH_SUPPORTS

	help
	  Turn any program that uses STDIN/STDOUT into a WebSocket server.
	  Like inetd, but for WebSockets.

	  http://websocketd.com/
```
